## CMakeLists.txt
```
#
# Copyright (c) 2019 Nordic Semiconductor
#
# SPDX-License-Identifier: LicenseRef-Nordic-5-Clause
#

cmake_minimum_required(VERSION 3.13.1)

find_package(Zephyr REQUIRED HINTS $ENV{ZEPHYR_BASE})
project("Profiler unit tests")

# # Include event headers
# zephyr_library_include_directories(src/events)

# Add test sources
target_sources(app PRIVATE src/main.c)
```

## prj.conf
```kconfig
#
# Copyright (c) 2019 Nordic Semiconductor ASA
#
# SPDX-License-Identifier: LicenseRef-Nordic-5-Clause
#

CONFIG_ZTEST=y

# Configuration required by Profiler
CONFIG_USE_SEGGER_RTT=y
CONFIG_PROFILER=y
CONFIG_PROFILER_NORDIC=y
CONFIG_PROFILER_NORDIC_DATA_BUFFER_SIZE=10000
CONFIG_PROFILER_NORDIC_START_LOGGING_ON_SYSTEM_START=y

# Custom reboot handler is implemented for test purposes
CONFIG_RESET_ON_FATAL_ERROR=n
CONFIG_REBOOT=n
```

## src/main.c
```c
/*
 * Copyright (c) 2021 Nordic Semiconductor ASA
 *
 * SPDX-License-Identifier: LicenseRef-Nordic-5-Clause
 */

#include <ztest.h>
#include <profiler.h>

#define MS_PER_TIMESTAMP_TICK 0.03125
#define PROFILED_EVENTS_NB 100
#define U_VALUE_START 0
#define S_VALUE_START -50
#define EXAMPLE_STRING "example string"

static uint16_t no_data_event_id;
static uint16_t data_event_id;
static uint16_t big_event_id;

static void profile_no_data_event(void)
{
	struct log_event_buf buf;

	profiler_log_start(&buf);
	profiler_log_send(&buf, no_data_event_id);
}

static void profile_data_event(const uint32_t val1)
{
	struct log_event_buf buf;

	profiler_log_start(&buf);
	profiler_log_encode_uint32(&buf, val1);
	profiler_log_send(&buf, data_event_id);
}

static void profile_big_event(const uint32_t val1, const int32_t val2, const uint16_t val3,
			      const int16_t val4, const uint8_t val5, const int8_t val6,
			      const char *string)
{
	struct log_event_buf buf;

	profiler_log_start(&buf);
	profiler_log_encode_uint32(&buf, val1);
	profiler_log_encode_int32(&buf, val2);
	profiler_log_encode_uint16(&buf, val3);
	profiler_log_encode_int16(&buf, val4);
	profiler_log_encode_uint8(&buf, val5);
	profiler_log_encode_int8(&buf, val6);
	profiler_log_encode_string(&buf, string);
	profiler_log_send(&buf, big_event_id);
}

static void register_profiler_events(void)
{
	static const char * const data_names[] = {"value1"};
	static const enum profiler_arg data_types[] = {PROFILER_ARG_U32};
	static const char * const big_event_data_names[] = {"value1", "value2", "value3",
							  "value4", "value5", "value6",
							  "string"};
	static const enum profiler_arg big_event_data_types[] = {PROFILER_ARG_U32,
								 PROFILER_ARG_S32,
								 PROFILER_ARG_U16,
								 PROFILER_ARG_S16,
								 PROFILER_ARG_U8,
								 PROFILER_ARG_S8,
								 PROFILER_ARG_STRING};
	no_data_event_id = profiler_register_event_type("no data event", NULL,
							NULL, 0);
	data_event_id = profiler_register_event_type("data event", data_names,
						     data_types, 1);
	big_event_id = profiler_register_event_type("big event", big_event_data_names,
						    big_event_data_types, 7);
}

void test_init(void)
{
	zassert_ok(profiler_init(), "Error when initializing");
	register_profiler_events();
}

static void test_performance1(void)
{
	uint32_t start_time;

	uint32_t elapsed_ticks;

	uint32_t elapsed_time_us;
	
	/* Profiling no data event */
	start_time = k_cycle_get_32();
	for (size_t i = 0; i < PROFILED_EVENTS_NB; i++) {
		profile_no_data_event();
	}
	elapsed_ticks = (uint32_t) k_cycle_get_32() - start_time;
	elapsed_time_us = (uint32_t) elapsed_ticks * MS_PER_TIMESTAMP_TICK * 1000;
	printk("Logged %s events with no data.\nElapsed time [us]: %d\n",
	       STRINGIFY(PROFILED_EVENTS_NB), elapsed_time_us);
}

static void test_performance2(void)
{
	uint32_t start_time;

	uint32_t elapsed_ticks;

	uint32_t elapsed_time_us;

	/* Profiling data event */
	start_time = k_cycle_get_32();
	for (size_t i = 0; i < PROFILED_EVENTS_NB; i++) {
		profile_data_event((const uint32_t) i);
	}
	elapsed_ticks = (uint32_t) k_cycle_get_32() - start_time;
	elapsed_time_us = (uint32_t) elapsed_ticks * MS_PER_TIMESTAMP_TICK * 1000;
	printk("Logged %s events with 4-byte data.\nElapsed time [us]: %d\n",
	       STRINGIFY(PROFILED_EVENTS_NB), elapsed_time_us);
}

static void test_performance3(void)
{
	uint32_t start_time;

	uint32_t elapsed_ticks;

	uint32_t elapsed_time_us;

	/* Profiling big data event */
	start_time = k_cycle_get_32();
	for (size_t i = 0; i < PROFILED_EVENTS_NB; i++) {
		profile_big_event((const uint32_t) i + U_VALUE_START,
				       (const int32_t) i + S_VALUE_START,
				       (const uint16_t) i + U_VALUE_START,
				       (const int16_t) i + S_VALUE_START,
				       (const uint8_t) i + U_VALUE_START,
				       (const int8_t) i + S_VALUE_START,
				       EXAMPLE_STRING);
	}
	elapsed_ticks = (uint32_t) k_cycle_get_32() - start_time;
	elapsed_time_us = (uint32_t) elapsed_ticks * MS_PER_TIMESTAMP_TICK * 1000;
	printk("Logged %s events with 28-byte data.\nElapsed time [us]: %d\n",
	       STRINGIFY(PROFILED_EVENTS_NB), elapsed_time_us);
}

void test_main(void)
{
	ztest_test_suite(profiler_tests,
			 ztest_unit_test(test_init),
			 ztest_unit_test(test_performance1),
			 ztest_unit_test(test_performance2),
			 ztest_unit_test(test_performance3)
			 );

	ztest_run_test_suite(profiler_tests);
}
```
