## subsys/bluetooth/services/fast_pair/Kconfig.fast_pair
```kconfig
#
# Copyright (c) 2022 Nordic Semiconductor
#
# SPDX-License-Identifier: LicenseRef-Nordic-5-Clause

menuconfig BT_FAST_PAIR
	bool "Fast Pair service"
	select BT_NRF_SERVICES
	default n
	help
	  Enable Fast Pair service.

if BT_FAST_PAIR

config BT_FAST_PAIR_CRYPTO
	bool
	select TINYCRYPT
	select TINYCRYPT_SHA256
	select TINYCRYPT_AES
	select TINYCRYPT_ECC_DH
	default y

endif # BT_FAST_PAIR
```

## tests/bluetooth/fast_pair_crypto/testcase.yaml
```yaml
tests:
  fast_pair.crypto:
    platform_exclude: native_posix qemu_x86 qemu_cortex_m3
    integration_platforms:
      - nrf51dk_nrf51422
      - nrf52dk_nrf52832
      - nrf52840dk_nrf52840
      - nrf5340dk_nrf5340
      - nrf9160dk_nrf9160ns
```

## tests/subsys/bluetooth/fast_pair/storage/factory_reset/testcase.yaml
```yaml
tests:
  fast_pair.storage.factory_reset.default:
    integration_platforms:
      - nrf52840dk_nrf52840
      #- qemu_x86
      - native_posix
      #- qemu_cortex_m3
      #- frdm_k64f
```
