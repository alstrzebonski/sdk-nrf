## applications/machine_learning/remote/Kconfig
```kconfig
#
# Copyright (c) 2024 Nordic Semiconductor ASA
#
# SPDX-License-Identifier: LicenseRef-Nordic-5-Clause
#

menu "Machine learning application (remote core)"

rsource "../common/Kconfig"

config APP_PROVIDE_PM_HOOKS
	bool "Application provides PM hooks"
	default y
	select HAS_PM
	select HAS_POWEROFF

endmenu

menu "Zephyr Kernel"
source "Kconfig.zephyr"
endmenu
```
